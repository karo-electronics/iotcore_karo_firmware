## imx-mkimage/iMX8M/u-boot-ddr3l.its
```
/dts-v1/;

/ {
	description = "Configuration to load ATF before U-Boot";

	images {
		uboot@1 {
			description = "U-Boot (64-bit)";
			data = /incbin/("u-boot-nodtb.bin");
			type = "standalone";
			arch = "arm64";
			compression = "none";
			load = <0x40200000>;
		};
		atf@1 {
			description = "ARM Trusted Firmware";
			data = /incbin/("bl31.bin");
			type = "firmware";
			arch = "arm64";
			compression = "none";
			load = <0x00920000>;
			entry = <0x00920000>;
		};
		tee@1 {
			description = "TEE firmware";
			data = /incbin/("tee.bin");
			type = "firmware";
			arch = "arm64";
			compression = "none";
			load = <0xbe000000>;
			entry = <0xbe000000>;
		};
		fdt@1 {
			description = "imx8mm-tx8m-1610-mipi-mb";
			data = /incbin/("imx8mm-tx8m-1610-mipi-mb.dtb");
			type = "flat_dt";
			compression = "none";
		};
	};
	configurations {
		default = "config@1";

		config@1 {
			description = "imx8mm-tx8m-1610-mipi-mb";
			firmware = "uboot@1";
			loadables = "atf@1", "tee@1";
			fdt = "fdt@1";
		};
	};
};
```

## u-boot/board/karo/tx8mm_evk/Kconfig
```kconfig
if TARGET_KARO_TX8MM_EVK

config SYS_BOARD
	default "tx8mm_evk"

config SYS_VENDOR
	default "karo"

config SYS_CONFIG_NAME
	default "tx8mm_evk"

config TX8MM_EVK
	bool
	default y
	select BOARD_LATE_INIT
	imply FEC_MXC
	select MII
	select PHYLIB
	select MXC_UART

choice
        prompt "U-Boot image variant"
	    default TX8MM_EVK_UBOOT

config TX8MM_EVK_UBOOT
        bool "Standard U-Boot image"

config TX8MM_EVK_UBOOT_MFG
        bool "U-Boot image for use with Freescale's MfGTool"
        select UBOOT_IGNORE_ENV

config TX8MM_EVK_UBOOT_NOENV
        bool "U-Boot using only built-in environment"
        select UBOOT_IGNORE_ENV

endchoice


endif
```

## u-boot/board/karo/tx8mm_evk_msport/Kconfig
```kconfig
if TARGET_KARO_TX8MM_EVK

config SYS_BOARD
	default "tx8mm_evk"

config SYS_VENDOR
	default "karo"

config SYS_CONFIG_NAME
	default "tx8mm_evk"

config SHOW_ACTIVITY
	bool "show led activity"



endif
```

## u-boot/configs/karo_tx8mm_evk_nt_defconfig
```kconfig
CONFIG_ARM=y
CONFIG_ARCH_IMX8M=y
CONFIG_SYS_TEXT_BASE=0x40200000
CONFIG_SPL_GPIO_SUPPORT=y
CONFIG_SPL_LIBCOMMON_SUPPORT=y
CONFIG_SPL_LIBGENERIC_SUPPORT=y
CONFIG_SYS_MALLOC_F_LEN=0x2000
CONFIG_TARGET_KARO_TX8MM_EVK=y
##CONFIG_TARGET_TX8M=y
CONFIG_SPL_MMC_SUPPORT=y
CONFIG_SPL_SERIAL_SUPPORT=y
CONFIG_SPL_DRIVERS_MISC_SUPPORT=y
CONFIG_SPL_WATCHDOG_SUPPORT=y
CONFIG_IMX_BOOTAUX=y
CONFIG_DEFAULT_DEVICE_TREE="imx8mm-tx8m-1610"
CONFIG_FIT=y
CONFIG_SPL_LOAD_FIT=y
CONFIG_OF_BOARD_SETUP=y
CONFIG_OF_SYSTEM_SETUP=y
CONFIG_SYS_EXTRA_OPTIONS="IMX_CONFIG=arch/arm/mach-imx/spl_sd.cfg,SPL_TEXT_BASE=0x7E1000,FB_ADDR=CONFIG_SYS_SDRAM_BASE"
CONFIG_SD_BOOT=y
CONFIG_BOOTDELAY=-2
CONFIG_USE_BOOTCOMMAND=y
CONFIG_BOOTCOMMAND="globalpage init 0x407E9000; globalpage add ethaddr; usb start; part list mmc ${mmcdev} devplist; for bootpar in ${devplist}; do part type mmc ${mmcdev}:${bootpar} part_type; if test ${part_type} = 1d30adf8-0aef-4d83-b78c-ac719086c709; then if read mmc ${mmcdev}:${bootpar} 0x40800000 0 1000; then bootm 0x40800000; fi; fi; done;"
CONFIG_PRE_CONSOLE_BUFFER=y
CONFIG_PRE_CON_BUF_ADDR=0x93F000
CONFIG_SYS_CONSOLE_INFO_QUIET=y
CONFIG_DEFAULT_FDT_FILE="imx8mm-tx8m-1610-mipi-mb.dtb"
CONFIG_VERSION_VARIABLE=y
CONFIG_SPL=y
CONFIG_SPL_BOARD_INIT=y
CONFIG_SPL_DISABLE_BANNER_PRINT=y
CONFIG_SYS_MMCSD_RAW_MODE_U_BOOT_USE_SECTOR=y
CONFIG_SYS_MMCSD_RAW_MODE_U_BOOT_SECTOR=0x300
CONFIG_SPL_I2C_SUPPORT=y
CONFIG_SPL_POWER_SUPPORT=y
CONFIG_SPL_USB_HOST_SUPPORT=y
CONFIG_SPL_USB_GADGET_SUPPORT=y
CONFIG_SPL_USB_SDP_SUPPORT=y
CONFIG_HUSH_PARSER=y
CONFIG_SYS_PROMPT="TX8M U-Boot > "
CONFIG_CMD_MEMTEST=y
CONFIG_CMD_CLK=y
# CONFIG_CMD_FLASH is not set
CONFIG_CMD_FUSE=y
CONFIG_CMD_GPIO=y
CONFIG_CMD_GPT=y
CONFIG_CMD_GPT_RENAME=y
CONFIG_CMD_I2C=y
CONFIG_CMD_MMC=y
CONFIG_CMD_PART=y
CONFIG_CMD_READ=y
CONFIG_CMD_USB=y
CONFIG_CMD_DHCP=y
CONFIG_CMD_MII=y
CONFIG_CMD_PING=y
CONFIG_CMD_CACHE=y
CONFIG_CMD_TIME=y
CONFIG_CMD_EXT2=y
CONFIG_CMD_EXT4=y
CONFIG_CMD_EXT4_WRITE=y
CONFIG_CMD_FAT=y
CONFIG_CMD_FS_GENERIC=y
CONFIG_EFI_PARTITION_ENTRIES_OFF=2048
CONFIG_PARTITION_TYPE_GUID=y
CONFIG_OF_CONTROL=y
CONFIG_OF_BOARD_FIXUP=y
CONFIG_ENV_IS_IN_MMC=y
CONFIG_ENV_VARS_UBOOT_CONFIG=y
CONFIG_BOOTP_DNS=y
CONFIG_BOOTP_GATEWAY=y
CONFIG_BOOTP_SUBNETMASK=y
CONFIG_DM_GPIO=y
CONFIG_MXC_GPIO=y
CONFIG_DM_I2C=y
CONFIG_SYS_I2C_MXC=y
CONFIG_LED=y
CONFIG_LED_GPIO=y
CONFIG_MXC_OCOTP=y
CONFIG_PHY_SMSC=y
CONFIG_DM_ETH=y
CONFIG_PINCTRL=y
CONFIG_PINCTRL_IMX8M=y
CONFIG_DM_REGULATOR=y
CONFIG_DM_THERMAL=y
CONFIG_NXP_TMU=y
CONFIG_USB=y
CONFIG_DM_USB=y
CONFIG_USB_EHCI_HCD=y
CONFIG_USB_GADGET=y
CONFIG_USB_GADGET_MANUFACTURER="FSL"
CONFIG_USB_GADGET_VENDOR_NUM=0x0525
CONFIG_USB_GADGET_PRODUCT_NUM=0xa4a5
CONFIG_CI_UDC=y
CONFIG_USB_GADGET_VBUS_DRAW=60
CONFIG_SDP_LOADADDR=0x40400000
CONFIG_USB_GADGET_DOWNLOAD=y
CONFIG_USB_FUNCTION_MASS_STORAGE=y
CONFIG_VIDEO=y
CONFIG_IMX_SEC_MIPI_DSI=y
CONFIG_SYS_CONSOLE_BG_COL=0xc0
CONFIG_SYS_CONSOLE_FG_COL=0x10
CONFIG_FAT_WRITE=y
CONFIG_OF_LIBFDT_OVERLAY=y
# CONFIG_EFI_LOADER is not set



# for Windows
CONFIG_SHOW_ACTIVITY=y
CONFIG_CMD_GLOBAL_PAGE=y
CONFIG_EFI_PARTITION=y
CONFIG_IMX_PERSIST_INIT=y

CONFIG_PARTITION_TYPE_GUID=y # support for part type command
```
