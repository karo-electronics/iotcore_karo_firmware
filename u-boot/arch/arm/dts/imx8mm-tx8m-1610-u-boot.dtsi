// SPDX-License-Identifier: (GPL-2.0 OR MIT)
/*
 * Copyright (C) 2019 Lothar Waßmann <LW@KARO-electronics.de>
 *
 */
#include "config.h"
#if defined(CONFIG_ENV_IS_IN_MMC)

/ {
	config {
		u-boot,mmc-env-offset = <CONFIG_ENV_OFFSET>;
	};
};
#endif
